## sdkconfig.defaults
```kconfig
# 唯一目标 ESP32-S3 的配置基准
CONFIG_IDF_TARGET="esp32s3"
CONFIG_WIFI_AP_SSID="ESP32-Config"
CONFIG_WIFI_AP_PASSWORD="12345678"
CONFIG_WIFI_CONNECT_TIMEOUT_SEC=60
CONFIG_FIRMWARE_VERSION=6

# 网络缓冲与调试配置
CONFIG_ESP_WIFI_ENABLED=y
CONFIG_ESP_WIFI_STATIC_RX_BUFFER_NUM=10
CONFIG_ESP_WIFI_DYNAMIC_RX_BUFFER_NUM=32
CONFIG_ESP_WIFI_DYNAMIC_TX_BUFFER_NUM=32
CONFIG_COMPILER_OPTIMIZATION_DEBUG=y
CONFIG_LOG_DEFAULT_LEVEL_INFO=y

# LVGL 软件渲染需要足够的主任务栈
CONFIG_ESP_MAIN_TASK_STACK_SIZE=8192

# 8MB flash，分区布局与资源烧录共用同一份表
CONFIG_ESPTOOLPY_FLASHSIZE_8MB=y
CONFIG_PARTITION_TABLE_CUSTOM=y
CONFIG_PARTITION_TABLE_CUSTOM_FILENAME="partitions_s3.csv"

# 配网页面文件系统
CONFIG_SPIFFS_MAX_PARTITIONS=3
CONFIG_SPIFFS_CACHE=y
CONFIG_SPIFFS_PAGE_SIZE=256
CONFIG_SPIFFS_OBJ_NAME_LEN=32
CONFIG_SPIFFS_USE_MAGIC=y
CONFIG_SPIFFS_USE_MTIME=y
CONFIG_ESP_DEFAULT_CPU_FREQ_MHZ_160=y

# HTTPS 证书校验与 TLS 会话复用
CONFIG_MBEDTLS_CERTIFICATE_BUNDLE=y
CONFIG_ESP_TLS_CLIENT_SESSION_TICKETS=y
```

## src/Kconfig
```kconfig
menu "RSS Display Configuration"

config WIFI_AP_SSID
    string "WiFi AP SSID"
    default "ESP32-Config"
    help
        SSID for the WiFi AP mode (config portal).

config WIFI_AP_PASSWORD
    string "WiFi AP Password"
    default "12345678"
    help
        Password for the WiFi AP mode. Must be at least 8 characters.

config WIFI_CONNECT_TIMEOUT_SEC
    int "WiFi connection timeout (seconds)"
    default 60
    range 10 300
    help
        Timeout for WiFi connection in STA mode.

config FIRMWARE_VERSION
    int "Firmware version"
    default 1
    help
        固件发布版本，仅用于显示，不影响持久化配置。

config BACKEND_BASE_URL
    string "Backend API base URL"
    default "http://192.168.3.122:8080"
    help
        后端根地址，设备会自动生成内容与评分 API 路径。

config DEVICE_ID
    string "Device ID override"
    default ""
    help
        留空表示首次启动时由芯片 MAC 生成唯一标识（例如 esp32s3-a1b2c3d4e5f6）
        并随配置保存，多台设备不会共用同一测试身份。
        填写后作为显式覆盖，已保存的显式标识不会被固件自动修改。

endmenu
```
